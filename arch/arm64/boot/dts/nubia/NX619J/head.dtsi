/*
 * nubia overwrite dts
 */


#include "others.dtsi"
#include "neo-power.dtsi"
#include "display.dtsi"
#include "tp.dtsi"
#include "finger.dtsi"
#include "sensors.dtsi"
#include "multicolor-led.dtsi"
#include "leds.dtsi"
#include "usb.dtsi"
#include "touchkey.dtsi"

