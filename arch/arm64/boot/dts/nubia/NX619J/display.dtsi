
#include "nubia-jdi-td4310-1080-2160-5p99-video.dtsi"

&soc {
        dsi_jdi_td4310_1080_2160_5p99_video_display: qcom,dsi-display@20 {
	        qcom,dsi-display-active;
                compatible = "qcom,dsi-display";
                label = "dsi_jdi_td4310_1080_2160_5p99_video_display";
                qcom,display-type = "primary";

                qcom,dsi-ctrl = <&mdss_dsi0>;
                qcom,dsi-phy = <&mdss_dsi_phy0>;
                clocks = <&mdss_dsi0_pll BYTECLK_MUX_0_CLK>,
                        <&mdss_dsi0_pll PCLK_MUX_0_CLK>;
                clock-names = "src_byte_clk", "src_pixel_clk";

                pinctrl-names = "panel_active", "panel_suspend";
                pinctrl-0 = <&sde_dsi_active &sde_te_active>;
                pinctrl-1 = <&sde_dsi_suspend &sde_te_suspend>;
                qcom,platform-reset-gpio = <&tlmm 6 0>;
                qcom,panel-mode-gpio = <&tlmm 32 0>;

                qcom,dsi-panel = <&dsi_jdi_td4310_1080_2160_5p99_video>;
                vddio-supply = <&pm8998_l14>;
                lab-supply = <&lab_regulator>;
                ibb-supply = <&ibb_regulator>;
    };
};

&dsi_jdi_td4310_1080_2160_5p99_video{
				qcom,panel-supply-entries = <&dsi_panel_pwr_supply>;

                                qcom,mdss-dsi-bl-pmic-control-type = "bl_ctrl_wled";
                                
                                qcom,mdss-dsi-mode-sel-gpio-state = "single_port";
                                qcom,platform-reset-gpio = <&tlmm 6 0>;
};
