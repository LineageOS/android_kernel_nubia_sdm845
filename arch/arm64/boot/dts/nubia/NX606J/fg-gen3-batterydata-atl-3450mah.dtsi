
qcom,atl_3450mah_step {
	qcom, = <24>;
	/* #3427735_ZTE_NX606J_3450mAh_averaged_MasterSlave_Apr9th2018*/
	qcom,max-voltage-uv = <4400000>;
	qcom,fg-cc-cv-threshold-mv = <4390>;
	qcom,nom-batt-capacity-mah = <3450>;
	qcom,batt-id-kohm = <15>;
	qcom,battery-beta = <4050>;
	qcom,battery-type = "atl_3450mah_step";
	qcom,checksum = <0x9840>;
	qcom,gui-version = "PMI8998GUI - 2.0.0.58";
	qcom,fg-profile-data = [
		 99 20 76 04
		 48 0B 97 05
		 ED 1C AA 01
		 BA 04 C8 03
		 AD 17 9B 23
		 E1 44 B1 53
		 87 00 00 00
		 12 00 00 00
		 00 00 58 CA
		 55 D5 B3 BD
		 2C 00 08 00
		 AA E2 94 ED
		 02 06 19 01
		 63 0C EE 01
		 1D E5 D6 2B
		 21 06 09 20
		 27 00 14 00
		 01 20 3D 05
		 C3 0A 01 06
		 CF 1C EC 02
		 07 0C 2A 12
		 89 18 D9 23
		 E4 4D 33 5B
		 6C 00 00 00
		 0E 00 00 00
		 00 00 4F D5
		 0C C3 3E CA
		 20 00 00 00
		 85 EB 94 ED
		 D6 06 FE EB
		 81 EC D6 02
		 58 DD E7 1A
		 AB 33 CC FF
		 07 10 00 00
		 63 0D 66 46
		 20 00 40 00
		 8C 01 0A FA
		 FF 00 00 00
		 00 00 00 00
		 00 00 00 00
		 00 00 00 00
		 00 00 00 00
		 00 00 00 00
		 00 00 00 00
		 00 00 00 00
		 00 00 00 00
		 00 00 00 00
		 00 00 00 00
		 00 00 00 00
		 00 00 00 00
		 00 00 00 00
		 00 00 00 00
		 00 00 00 00
		 00 00 00 00
		 00 00 00 00
		 00 00 00 00
	];
};
