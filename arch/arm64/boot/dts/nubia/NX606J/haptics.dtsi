/*
 * Copyright (c) 2015-2016, The Linux Foundation. All rights reserved.
 *
 * This program is free software; you can redistribute it and/or modify
 * it under the terms of the GNU General Public License version 2 and
 * only version 2 as published by the Free Software Foundation.
 *
 * This program is distributed in the hope that it will be useful,
 * but WITHOUT ANY WARRANTY; without even the implied warranty of
 * MERCHANTABILITY or FITNESS FOR A PARTICULAR PURPOSE.  See the
 * GNU General Public License for more details.
 */

/*****haptics start *****/

&spmi_bus {
	pmi8998_lsid1_sensor:qcom,pmi8998@3 {
		pmi8998_haptics_sensor:qcom,haptics@c000 {
			compatible = "qcom,qpnp-haptics";
			reg = <0xc000 0x100>;
			interrupts = <0x3 0xc0 0x0 IRQ_TYPE_EDGE_BOTH>,
					 <0x3 0xc0 0x1 IRQ_TYPE_EDGE_BOTH>;
			interrupt-names = "hap-sc-irq", "hap-play-irq";
			qcom,pmic-revid = <&pmi8998_revid>;
			qcom,pmic-misc = <&pmi8998_misc>;
			qcom,misc-clk-trim-error-reg = <0xf3>;
			qcom,actuator-type = <0>;
			qcom,play-mode = "buffer";
			qcom,wave-samples = [7e 7e 7e 28 28 28 28 28];
			qcom,wave-play-rate-us = <4878>;
			qcom,int-pwm-freq-khz = <505>;
			qcom,vmax-mv = <1800>;
			qcom,ilim-ma = <800>;
			qcom,sc-dbc-cycles = <8>;
			qcom,en-brake;
			qcom,lra-high-z = "opt1";
			qcom,lra-auto-res-mode = "qwd";
			qcom,lra-res-cal-period = <4>;
			qcom,correct-lra-drive-freq;
			qcom,ztemt_vibrator_ms =<0>;
			status = "ok";
		};

	};
};
