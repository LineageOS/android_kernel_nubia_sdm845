## drivers/nubia/Kconfig
```kconfig
#
# Nubia drivers configuration
#

#menuconfig NUBIA_DRIVERS
menu "nubia drivers"

config NUBIA_DRIVERS
	bool "NUBIA DRIVERS"
	default y
	help
	  Say Y here if you want to enable NUBIA DRIVERS
	  If unsure, say N.

comment "Nubia Device Drivers"

if NUBIA_DRIVERS

config NUBIA_FINGERPRINT
	bool "NUBIA_FINGERPRINT"
	default y
	help
	 Say Y here if you have enable NUBIA_FINGERPRINT
	 IF  unsure ,say N

config NUBIA_TOUCH
	bool "NUBIA_TOUCH"
	default n
	help
	 Say Y here if you have enable NUBIA_FINGERPRINT
	 IF  unsure ,say N

endif


if NUBIA_FINGERPRINT
source "drivers/nubia/fingerprint/Kconfig"
endif

if NUBIA_TOUCH
source "drivers/nubia/touch/Kconfig"
endif

endmenu

# Nubia configuration options

config MACH_NUBIA
    bool "NUBIA device"
    depends on ARCH_QCOM
    help
      Support for Nubia products

config MACH_NUBIA_SDM845
    bool "NUBIA SDM845"
    depends on ARCH_SDM845
    select MACH_NUBIA
    help
      Support for SDM845 Nubia variants

menu "Nubia board selection"

config MACH_NUBIA_NX606J
    bool "NUBIA_NX606J board"
    select MACH_NUBIA_SDM845
    help
      Support for Nubia Z18 variant

config MACH_NUBIA_NX616J
    bool "NUBIA_NX616J board"
    select MACH_NUBIA_SDM845
    help
      Support for Nubia X variant

config MACH_NUBIA_NX619J
    bool "NUBIA_NX619J board"
    select MACH_NUBIA_SDM845
    help
      Support for Nubia Red Magic Mars variant

endmenu
```
